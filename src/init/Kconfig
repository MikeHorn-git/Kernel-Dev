## src/init/custom/Kconfig
```kconfig
config HELLO
    bool "Enable custom Hello syscall"
    default y
    help
        print "Hello world"

config SYS_UPTIME
    bool "Enable uptime() syscall"
    default y
    help
        print "uptime()"
```
